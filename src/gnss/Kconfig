## src/gnss/Kconfig
```kconfig
#
# Copyright (c) 2021 Nordic Semiconductor ASA
#
# SPDX-License-Identifier: LicenseRef-Nordic-5-Clause

config SLM_GNSS
	bool "GNSS support in SLM"
	default y

if SLM_GNSS

config SLM_AGPS
	bool "Use nRF Cloud A-GPS"
	depends on NRF_CLOUD_AGPS
	depends on NRF_CLOUD_MQTT
	help
	  Use nRF Cloud A-GPS in GPS operation

config SLM_PGPS
	bool "Use nRF Cloud P-GPS"
	depends on NRF_CLOUD_PGPS
	depends on NRF_CLOUD_MQTT
	help
	  Use nRF Cloud P-GPS in GPS operation

config SLM_CELL_POS
	bool "Use nRF Cloud cellular positioning"
	depends on AT_MONITOR
	depends on NRF_CLOUD_CELL_POS
	depends on NRF_CLOUD_MQTT
	help
	  Request nRF Cloud cellular positioning service

config SLM_NMEA_UART_2
	bool "Use UART 2 for NMEA"
	help
	  Use UART 2 for NMEA

endif # SLM_GNSS
```
